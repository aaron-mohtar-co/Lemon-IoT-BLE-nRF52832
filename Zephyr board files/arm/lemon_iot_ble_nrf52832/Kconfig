## Zephyr board files/arm/lemon_iot_ble_nrf52832/Kconfig
```kconfig
# nRF52 board configuration

# Copyright (c) 2023 Aaron Mohtar & Co Pty Ltd
# Copyright (c) 2016 Nordic Semiconductor ASA
# SPDX-License-Identifier: Apache-2.0

config BOARD_ENABLE_DCDC
	bool "DCDC mode"
	select SOC_DCDC_NRF52X
	default y
	depends on BOARD_LEMON_IOT_BLE_NRF52832
```

## Zephyr board files/arm/lemon_lte_nrf52832/Kconfig.board
```kconfig
# nRF52832 Lemon IoT BLE board configuration

# Copyright (c) 2023 Aaron Mohtar & Co Pty Ltd
# Copyright (c) 2016 Nordic Semiconductor ASA
# SPDX-License-Identifier: Apache-2.0

config BOARD_LEMON_IOT_NRF52832
	bool "nRF52832 Lemon IoT LTE"
	depends on SOC_NRF52832_QFAA
```

## Zephyr board files/arm/lemon_lte_nrf52832/lemon_iot_nrf52832_defconfig
```kconfig
# SPDX-License-Identifier: Apache-2.0

CONFIG_SOC_SERIES_NRF52X=y
CONFIG_SOC_NRF52832_QFAA=y

# Enable MPU
CONFIG_ARM_MPU=y

# Enable hardware stack protection
CONFIG_HW_STACK_PROTECTION=y

# Enable GPIO
CONFIG_GPIO=y

# Enable UART driver
CONFIG_SERIAL=y

# Enable console
CONFIG_CONSOLE=y
CONFIG_UART_CONSOLE=y

# Additional board options
CONFIG_GPIO_AS_PINRESET=y

CONFIG_PINCTRL=y
```

## Zephyr board files/hwmodelv1/arm/lemon_iot_ble_nrf52832/Kconfig.board
```kconfig
# nRF52832 Lemon IoT BLE board configuration

# Copyright (c) 2023 Aaron Mohtar & Co Pty Ltd
# Copyright (c) 2016 Nordic Semiconductor ASA
# SPDX-License-Identifier: Apache-2.0

config BOARD_LEMON_IOT_BLE_NRF52832
	bool "Lemon IoT BLE nRF52832"
	depends on SOC_NRF52832_QFAA
```

## Zephyr board files/hwmodelv1/arm/lemon_iot_ble_nrf52832/Kconfig.defconfig
```kconfig
# nRF52 DK NRF52832 board configuration

# Copyright (c) 2023 Aaron Mohtar & Co Pty Ltd
# Copyright (c) 2016 Nordic Semiconductor ASA
# SPDX-License-Identifier: Apache-2.0

if BOARD_LEMON_IOT_BLE_NRF52832

config BOARD
	default "lemon_iot_ble_nrf52832"

config BT_CTLR
	default BT

endif # BOARD_LEMON_IOT_BLE_NRF52832
```

## Zephyr board files/hwmodelv2/lemon-iot/lemon_iot_ble_nrf52832/Kconfig.defconfig
```kconfig
if BOARD_LEMON_IOT_BLE_NRF52832

config BT_CTLR
	default BT

endif # BOARD_LEMON_IOT_BLE_NRF52832
```

## Zephyr board files/hwmodelv2/lemon-iot/lemon_iot_ble_nrf52832/board.yml
```yaml
board:
  name: lemon_iot_ble_nrf52832
  vendor: lemon-iot
  socs:
    - name: nrf52832
```
